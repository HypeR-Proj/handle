## Kconfig
```kconfig
# SPDX-FileCopyrightText: 2026 roolrz
# SPDX-License-Identifier: Apache-2.0

config SYSTEM_APP_HANDLE
    bool "handle (/bin/handle)"
    default y
    help
        Build and deploy hyper-handle at /bin/handle.
```
